## config/west.yml
```yaml
manifest:
  remotes:
    - name: zmkfirmware
      url-base: https://github.com/zmkfirmware
    - name: ecstatic-morse
      url-base: https://github.com/ecstatic-morse
  projects:
    - name: zmk
      remote: zmkfirmware
      revision: main
      import: app/west.yml
    - name: molock
      remote: ecstatic-morse
      revision: molock
      import: app/west.yml
  self:
    path: config
```
