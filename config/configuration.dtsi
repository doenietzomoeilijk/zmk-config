#define KEYS_L LT0 LT1 LT2 LT3 LT4 LT5 LM0 LM1 LM2 LM3 LM4 LM5 LB0 LB1 LB2 LB3 LB4 LB5 LF0 LF1 LF2 LF3 LF4 LF5
#define KEYS_R RT0 RT1 RT2 RT3 RT4 RT5 RM0 RM1 RM2 RM3 RM4 RM5 RB0 RB1 RB2 RB3 RB4 RB5 RF0 RF1 RF2 RF3 RF4 RF5
#define THUMBS LH3 LH2 LH1 LH0 RH0 RH1 RH2 RH3

&lt {
    tapping-term-ms = <300>;
    flavor = "balanced";
    quick-tap-ms = <150>;
    require-prior-idle-ms = <150>;
};
&sl {
    release-after-ms = <2000>;
};
